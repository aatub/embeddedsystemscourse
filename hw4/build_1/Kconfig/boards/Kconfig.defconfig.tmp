## hw4/build_1/Kconfig/boards/Kconfig.defconfig.tmp
```kconfig
# Load Zephyr board defconfig descriptions.
osource "C:/ncs/v3.4.0/zephyr/boards/nordic/nrf5340_audio_dk/Kconfig.defconfig"
```

## hw4/build_1/Kconfig/boards/Kconfig.nrf5340_audio_dk.tmp
```kconfig
# Load board Kconfig descriptions.
osource "C:/ncs/v3.4.0/zephyr/boards/nordic/nrf5340_audio_dk/Kconfig.nrf5340_audio_dk"
```

## hw4/build_1/Kconfig/boards/Kconfig.sysbuild.tmp
```kconfig
# Load Sysbuild board Kconfig descriptions.
osource "C:/ncs/v3.4.0/zephyr/boards/nordic/nrf5340_audio_dk/Kconfig.sysbuild"
```
